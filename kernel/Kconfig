## kernel/Kconfig
```kconfig
menu "KernelSU"

config KSU
      tristate "KernelSU function support"
      default y
      help
        Enable kernel-level root privileges on Android System.
        To compile as a module, choose M here: the
        module will be called kernelsu.

config KSU_DEBUG
      bool "KernelSU debug mode"
      depends on KSU
      default n
      help
        Enable KernelSU debug mode.

config KSU_MULTI_MANAGER_SUPPORT
    bool "Multi KernelSU manager support"
    depends on KSU
    default n
    help
        Enable multi KernelSU manager support


config KSU_ALLOWLIST_WORKAROUND
    bool "KernelSU Session Keyring Init workaround"
    depends on KSU
    default n
    help
      Enable session keyring init workaround for problematic devices.
      Useful for situations where the SU allowlist is not kept after a reboot

config KPM
      bool "Enable SukiSU KPM"
      depends on KSU && 64BIT
      select KALLSYMS
      select KALLSYMS_ALL
      default n
      help
        Enabling this option will activate the KPM feature of SukiSU.
        This option is suitable for scenarios where you need to force KPM to be enabled.
        but it may affect system stability.

config KSU_MANUAL_HOOK
    bool "Hook KernelSU manually"
    depends on KSU != m
    help
      If enabled, Hook required KernelSU syscalls with manually-patched function.

endmenu
```
